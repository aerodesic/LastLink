## main/Kconfig.sensors
```kconfig
menu "Sensors"
    config LASTLINK_SENSORS_ENABLE
        bool "Enable sensor support"
        default true
        help
            Enables published and poll sensors.

    config LASTLINK_SENSORS_PLATFORM_NAME
        string "Sensors platform name"
        depends on LASTLINK_SENSORS_ENABLE
        default "sensors"
        help
            This specifies the name of the 'sensors' list for this platform.

    config LASTLINK_SENSORS_WELL_KNOWN_PORT
        int "Port broadcasting sensor information"
        depends on LASTLINK_SENSORS_ENABLE
        default 2
        range 2 5000
        help
            New sensor data is broadcast on this port.  Each platform may choose
            a different port to disambiguate requests.

    config LASTLINK_SENSORS_SERVICE_LIFETIME
        int "Sensor service lifetime"
        depends on LASTLINK_SENSORS_ENABLE
        default 120
        range 60 3600
        help
            Defines update interval for republishing sensor service.

    config LASTLINK_SENSORS_MAX_NAME_LENGTH
        int "Maximum length of a sensor name"
        depends on LASTLINK_SENSORS_ENABLE
        default 16
        range 16 64
        help
            Maximum character length of a sensor name.

    config LASTLINK_SENSORS_MAX_SCON_CONNECTIONS
        int "Maximum scon command connections"
        depends on LASTLINK_SENSORS_ENABLE
        default 5
        range 3 16
        help
            Maximum number of command interface connections to SCON interface.

    config LASTLINK_SENSORS_MAX_VALUE_LENGTH
        int "Maximum length of a sensor value"
        depends on LASTLINK_SENSORS_ENABLE
        default 16
        range 16 64
        help
            Maximum character length of a sensor value.

    config LASTLINK_SENSORS_DHT_ENABLE
        depends on LASTLINK_SENSORS_ENABLE
        bool "Report DHT sensor values"
        select DHT_ENABLE
        default false
        help
            Add DHT (Humidity and Temperature) sensor to reported list.

    menuconfig LASTLINK_SENSORS_GPS_ENABLE
        depends on LASTLINK_SENSORS_ENABLE
        bool "Report GPS"
        default false
        help
            Add GPS to available sensors

    if LASTLINK_SENSORS_GPS_ENABLE
        config LASTLINK_SENSORS_GPS_PORT_NUMBER
            depends on LASTLINK_SENSORS_GPS_ENABLE
            int "GPS UART port number"
            default 2
            help
                UART Port number connected to GPS device.
    
        config LASTLINK_SENSORS_GPS_RX_PIN
            depends on LASTLINK_SENSORS_GPS_ENABLE
            int "GPS UART RX pin"
            default 34
            help
                UART RX GPIO Pin
    
        config LASTLINK_SENSORS_GPS_TX_PIN
            depends on LASTLINK_SENSORS_GPS_ENABLE
            int "GPS UART TX pin"
            default 12
            help
                UART TX GPIO Pin
    
        source "main/Kconfig.nmea"
    endif

endmenu
```

## main/Kconfig.service_names
```kconfig
menu "Service Name Manager"
    config LASTLINK_SERVICE_NAMES_ENABLE
        bool "Enable service names"
        depends on LASTLINK_ENABLE_SOCKET_LAYER
        default true
        help
            Enable service names.  These are names published by
            a node that refer to a published service on a specific
            port type and port number.
    
    config LASTLINK_SERVICE_NAMES_MAX_LEN
        int "Maximum length of sevice name"
        default 16
        depends on LASTLINK_SERVICE_NAMES_ENABLE
        help
            The maximum characters in a service name.
    
    config LASTLINK_SERVICE_NAMES_REPLY_TIMEOUT
        int "Timeout in mS waiting for service reply"
        default 1000
        range 50 20000
        depends on LASTLINK_SERVICE_NAMES_ENABLE
        help
            This is the timeout while waiting for a service name lookup.
    
    config LASTLINK_SERVICE_NAMES_REPLY_RETRIES
        int "Number of retries to lookup service name"
        default 5
        range 1 20
        depends on LASTLINK_SERVICE_NAMES_ENABLE
        help
            "Number of tries to lookup service name
    
    config LASTLINK_SERVICE_NAMES_WAIT_TIMEOUT
        int "Timeout in mS waiting for service request in scanner"
        default 100
        range 50 10000
        depends on LASTLINK_SERVICE_NAMES_ENABLE
        help
            This is the timeout while waiting for a service name request.
            It is the basic loop time for the service request scanner
            and controls the interval over which old services are removed.
    
    
    config LASTLINK_SERVICE_NAMES_LIFETIME
        int "Cache timeout in seconds of a service entry after publishing"
        default 300
        range 1 3600
        depends on LASTLINK_SERVICE_NAMES_ENABLE
        help
            This is the timeout after which a local service name
            entry will be deleted after received.
    
    config LASTLINK_SERVICE_NAMES_PORT
        int "Well known port for service lookup"
        default 1
        range 1 5000
        depends on LASTLINK_SERVICE_NAMES_ENABLE
        help
            This is the well known port over which a service lookup is performed.
endmenu
```
