## main/Kconfig.projbuild
```kconfig
menu "LastLink Configuration"
    menu "Other Configuration"
        config LASTLINK_CONFIG_FILE
            string "Name of config file"
            default "/spiffs/.config"
            help
                Enter the name of the configuation control file

        config SPIFFS_PARTITION_NAME
            string "Name of SPIFFS partition"
            default "storage"
            help
                Enter the name of the spiffs partition as used in the parition table.

        config LASTLINK_WEB_SERVER_ENABLED
            bool "Enable web server"
            default y
            help
                "Enable a web server for local access"

        choice
            prompt "Choose type of web server"
            depends on LASTLINK_WEB_SERVER_ENABLED

            config LASTLINK_HTTP_SERVER_ENABLED
                bool "HTTP"
                help
                    Use HTTP server for user connection.

            config LASTLINK_HTTPS_SERVER_ENABLED
                bool "HTTPS"
                select ESP_HTTPS_SERVER_ENABLE
                help
                    Enable the HTTPS server for user connection.

        endchoice

        config LASTLINK_MDNS_ENABLED
            bool "Activate MDNS server"
            depends on LASTLINK_WEB_SERVER_ENABLED
            default y
            help
                Select to enable MDNS server activation. 

        config LASTLINK_HTTP_REDIRECT_ENABLED
            bool "Enable HTTP redirect"
            depends on LASTLINK_HTTPS_SERVER_ENABLED
            default y
            help
                Enable redirecting HTTP -> HTTPS automatically.

        config LASTLINK_HTML_DIRECTORY
            depends on LASTLINK_WEB_SERVER_ENABLED
            string "Directory containing html files"
            default "/spiffs/html"
            help
                The directory containing the html, css and js files
       
        config LASTLINK_AUTHTOKEN_EXPIRE_TIME
            depends on LASTLINK_WEB_SERVER_ENABLED
            int "Authtoken expire time (seconds)"
            default 3600
            help
                Time (in seconds) for AUTHTOKEN to expire.

        config LASTLINK_ADDED_HEAP_CAPS_CHECK
            bool "Add extra calls to check heap"
            default y
            help
                Enable extra runtime heap checking.


    endmenu

    config LASTLINK_RECEIVE_ONLY_FROM_TABLE
        int "Length of receive-only debug table"
        default 0
        help
            This table will define a list of address from which this node
            will only accept packets.  This is used to test a network environment
            where all nodes are close but we want to limit paths to simulate
            a disperse array.  A blank string means no limits.

            The contents of this table is filled from a configuration variable.

    config LASTLINK_EXTRA_DEBUG_COMMANDS
        bool "Add table debug commands"
        default y
        help
            If enabled, adds extra table lists to command  processor.

    config LASTLINK_WIFI_SSID
        string "WiFi SSID"
        default "LastLink"
        help
            SSID (network name) for the example to connect to.

    config LASTLINK_WIFI_PASSWORD
        string "WiFi Password"
        default ""
        help
            WiFi password (WPA or WPA2) for the example to use.

    config LASTLINK_MAX_STA_CONN
        int "Maximal STA connections"
        default 4
        help
            Max number of the STA connects to AP.

    config LASTLINK_RADIO_SX126x_ENABLED
        bool "Enable SX126x Driver"
        default n

    config LASTLINK_RADIO_SX127x_ENABLED
        bool "Enable SX127x Driver"
        default y

    config LASTLINK_LED_ACTIVITY_GPIO
        int "Activity (TRANSMIT) led GPIO"
        default 0

    menu "Radio configuration"
        # Currently up to 8 radios
        RADIO_NUM:=1
        DEFAULT_RADIO_ENABLE=y
        source "main/Kconfig.radio"

        DEFAULT_RADIO_ENABLE=n
        RADIO_NUM:=2
        source "main/Kconfig.radio"

        RADIO_NUM:=3
        source "main/Kconfig.radio"

        RADIO_NUM:=4
        source "main/Kconfig.radio"

        RADIO_NUM:=5
        source "main/Kconfig.radio"

        RADIO_NUM:=6
        source "main/Kconfig.radio"

        RADIO_NUM:=7
        source "main/Kconfig.radio"

        RADIO_NUM:=8
        source "main/Kconfig.radio"

    endmenu

    menu "Communication Parameters"

        config LASTLINK_ROUTE_LIFETIME
            int "Route Lifetime in mS"
            default 15000
            help
                This defines the time a route will exist before requiring
                a new RouteRequest to be performed.

        config LASTLINK_MAX_ROUTES
            int "Maximum number of routes in table"
            default 64
            help
                Sets the maximum number of route table entries per device.

        config LASTLINK_ROUTE_REQUEST_TIMEOUT
            int "Route Request Timeout"
            default 5000
            range 5000 30000
            help
                Timeout for waiting for a RouteAnnounce from a RouteRequest.

        config LASTLINK_ROUTE_REQUEST_RETRIES
            int "Route Request Retries"
            default 5
            range 3 25
            help
                Number of retries to receive a RouteAnnounce from RouteRequest.

        config LASTLINK_ROUTE_MAX_QUEUED_PACKETS
            int "Route max queued packets"
            default 20
            range 3 100
            help
                The maximum number of packets queuable while waiting for a route.

        config LASTLINK_MAX_PROTOCOL_NUMBER
            int "Maximum packet protocol number"
            default 10
            range 8 250
            help
                The maximum protocol number allowed (starts with 0)
                (0 to 7 are used internally.)

        config LASTLINK_CHANNEL_TABLE
            string "Select channel table"
            default "us902_928"
            help
                Select one of the channel table files

    endmenu

    menu "Additional Applications"
        source "main/Kconfig.service_names"
        source "main/Kconfig.ftp"
    endmenu

    menu "Packet Configuration"
        config LASTLINK_DEBUG_PACKET_ALLOCATION
            bool "Debug packet allocation"
            default n
            help
                Adds test code in packet allocation and release to
                determine who the last referenced caller that
                allocated or released the packet.  

        config LASTLINK_NUM_PACKETS
            int "Number of available packets"
            default 100
            help
                This defines the number of packets available.  No additional
                memory is allocated beyond this limit, so if you run out,
                packets will be dropped.

        config LASTLINK_MAX_PACKET_LENGTH
            int "Packet length"
            default 255
            help
                Warning: Hardware in most cases limits this to 255.
                Change with caution...  Note that adding CRC will limit
                the useful payload by 2 bytes.

        config LASTLINK_CRC16_PACKETS
            bool "Add 2 byte crc16 to packet data payload."
            default y
            help
                This shortens the useful payload by two bytes at the
                expense of validating transfers to and from the radio
                buffers.

        config LASTLINK_ADDRESS_LENGTH
            int "Length of an address"
            default 2
            range 1 6
            help
                Number of bytes in Address field.

        config LASTLINK_BROADCAST_ADDRESS
            hex "A Broadcast address"
            default 0xFFFF
            help
                The address used for a broadcast to all nodes

        config LASTLINK_NULL_ADDRESS
            hex "A NULL address"
            default 0x0000
            help
                The address used when an address is unspecified.
                Used to mark packets that need to be labeled with
                source, destination and route.  This value cannot
                be used as a node address.

        config LASTLINK_PROTOCOL_LENGTH
            int "Length of Protocol type field"
            default 1
            range 1 4
            help
                Number of bytes in a protocol type field

        config LASTLINK_FLAGS_LENGTH
            int "Length of Flags field"
            default 1
            range 1 4
            help
                The number of bytes in Flags field.

        config LASTLINK_SEQUENCE_NUMBER_LENGTH
            int "Length of a sequence number"
            default 2
            range 1 4
            help
                The number of bytes in a SEQUENCE_NUMBER field.

#        config LASTLINK_SEQUENCE_NUMBER_DUPLICATE_RANGE
#            int "Sequence number duplicate range"
#            default 32
#            range 16 32768
#            help
#                Sequence numbers closer than this to last sequence
#                number are considered duplicate and discarded.  This
#                number needs be large than the window size and should
#                be several times larger.

        config LASTLINK_INTERVAL_LENGTH
            int "Length of a interval number"
            default 2
            range 1 4
            help
                The number of bytes in an INTERVAL field.

        config LASTLINK_METRIC_LENGTH
            int "Length of a metric field in bytes"
            default 1
            range 1 4
            help
                The number of bytes in a METRIC field.

        config LASTLINK_MAX_METRIC
            int "Maximum value of a metric"
            default 64
            range 1 256
            help
                The maximum METRIC value (distance from origin)

        config LASTLINK_BEACON_NAME_LENGTH
           int "Length of name in beacon packet"
           default 16
           range 10 128
           help
               The number of bytes available for a node name in the beacon.

        config LASTLINK_REASON_LENGTH
           int "Length of reason field in RouteError"
           default 16
           range 10 128
           help
               The number of bytes available for a reason in the RouteError.

    endmenu

    menu "Socket layer"

        config LASTLINK_ENABLE_SOCKET_LAYER
        bool "Select to enable socket manager"
        default true
        help
             Enables datagram and streaming sockets between nodes.

        config LASTLINK_NUMBER_OF_SOCKETS
        int "Number of sockets"
        depends on LASTLINK_ENABLE_SOCKET_LAYER
        default 10
        help
             Sets the maximum number of active listening or connected sockets.

        config LASTLINK_MAX_OUTSTANDING_PINGS
        int "Number of simultaneous pings allowed"
        depends on LASTLINK_ENABLE_SOCKET_LAYER
        default 5
        help
            Defines the table controlling the maximum pings outstanding
            at one time.

        config LASTLINK_PING_RETRY_TIMER
        int "mS to wait for ping reply"
        depends on LASTLINK_ENABLE_SOCKET_LAYER
        default 5000
        help
            How long the ping function waits for a reply after it has been routed.

        config LASTLINK_PING_RETRIES
        int "Number of retries for PING"
        depends on LASTLINK_ENABLE_SOCKET_LAYER
        default 5
        range 3 20
        help
            This many attempts will be made to resend a ping after it
            has been routed.

        config LASTLINK_STREAM_WINDOW_SIZE
        depends on LASTLINK_ENABLE_SOCKET_LAYER
        int "Number of packets in input/output windows"
        default 3
        range 1 15
        help
            This value defines the number of packets that may be sent at a time
            while waiting for an acknowledgement.  A large number means fewer
            acks required for a properly operating network, while a smaller
            number means better efficiency if a noisy or marginal network.
            This sets the sizes of the outbound packet queue and the packet
            assembly buffer on input.

        config LASTLINK_STREAM_ACK_DELAY
        depends on LASTLINK_ENABLE_SOCKET_LAYER
        int "Delay (in mS) between receiving a packet and the automatic ack"
        default 500
        range 50 5000
        help
            This value determines how long a stream will wait to acknowledge a
            packet if there is no traffic going back to the sender.  ACKS are
            piggy-backed on all data packets, so they are delayed in case
            a bi-directional data path will be active.

        config LASTLINK_STREAM_TRANSMIT_RETRIES
        depends on LASTLINK_ENABLE_SOCKET_LAYER
        int "Number of stream packet retries"
        default 10
        range 2 50
        help
            The number of times to retry sending the output queue before giving up.

        config LASTLINK_STREAM_TRANSMIT_OVERHEAD_TIME
        depends on LASTLINK_ENABLE_SOCKET_LAYER
        int "Base packet overhead time"
        default 300
        range 0 5000
        help
            This is a base time (in milliseconds) added to every calculation
            of packet transmission time estimates.

        config LASTLINK_STREAM_TRANSMIT_RETRY_FACTOR
        depends on LASTLINK_ENABLE_SOCKET_LAYER
        int "Packet retransmit factor"
        default 100
        range 50 1000
        help
            This factor (represented as a percentage) represents the
            amount of time to expect completion of a message transmitted
            to a target node and a reply returned to the send (considering
            the number of hops involved).  The calculation is:

                FACTOR * (<message time> * (<hops to target> * 4 - 2)) / 100

            Each message must take path that is an inbound and outbound
            delay to each node except the first and last. and the response
            must travel back the same path.

        config LASTLINK_STREAM_TRANSMIT_MAXIMUM_RETRY_TIME
        depends on LASTLINK_ENABLE_SOCKET_LAYER
        int "Maximum retry interval"
        default 5000
        range 1000 20000
        help
            The maximum backoff between retries.


        config LASTLINK_STREAM_TRANSMIT_DELAY
        depends on LASTLINK_ENABLE_SOCKET_LAYER
        int "How long (in mS) to hold a packet with data before it is sent"
        default 500
        range 50 5000
        help
            This value determines how long a packet with fresh data will stay
            in the output queue before it is sent.


        config LASTLINK_STREAM_KEEP_ALIVE_ENABLE
        depends on LASTLINK_ENABLE_SOCKET_LAYER
        bool "Enable keep-alive packets for socket"
        default false
        help
             If set, keep-alive packets will go between socket endpoints
             every <N> seconds determined by KEEP ALIVE timer.


        config LASTLINK_STREAM_KEEP_ALIVE_TIME
        depends on LASTLINK_ENABLE_SOCKET_LAYER
        depends on LASTLINK_STREAM_KEEP_ALIVE_ENABLE
        int "Seconds between keep-alive packets"
        default 10
        range 10 3600


        config LASTLINK_STREAM_UPDATE_TIME
        depends on LASTLINK_ENABLE_SOCKET_LAYER
        int "milliseconds to ACK input on outstanding read"
        default 1000
        range 50 30000
        help
            This is the period to retransmit ACKs for input window
            that have a read-in-process and do not have a full window.
            It is expressed in milliseconds, but is adjusted by the metric
            delay to the originating node so as not to produce ACKS
            faster than should be able to propagate through the network.

        config LASTLINK_SOCKET_LINGER_TIME
        depends on LASTLINK_ENABLE_SOCKET_LAYER
        int "Time to 'linger' socket after closing"
        default 5000
        range 1000 60000
        help
            Time in milliseconds after socket closes before it is
            cleaned and reclaimed.

    endmenu

endmenu
```
