## main/Kconfig.radio
```kconfig
#
# Define the characteristics of a radio
#
config LASTLINK_RADIO_$(RADIO_NUM)_ENABLED
    bool "Enable radio $(RADIO_NUM)"
    depends on LASTLINK_RADIO_SX126x_ENABLED || LASTLINK_RADIO_SX127x_ENABLED
    default $(DEFAULT_RADIO_ENABLE)
 
choice
    depends on LASTLINK_RADIO_$(RADIO_NUM)_ENABLED
    depends on LASTLINK_RADIO_SX126x_ENABLED || LASTLINK_RADIO_SX127x_ENABLED

    prompt "Radio device selection"
    default LASTLINK_RADIO_$(RADIO_NUM)_SX127x_SPI
    help
        Selects the connection used for radio $(RADIO_NUM)

    config LASTLINK_RADIO_$(RADIO_NUM)_SX1261_SPI
        bool "Select SX1261 Family (SPI)"
        depends on LASTLINK_RADIO_SX126x_ENABLED
        select LASTLINK_RADIO_$(RADIO_NUM)_SX126x_SPI

    config LASTLINK_RADIO_$(RADIO_NUM)_SX1262_SPI
        bool "Select SX1262 Family (SPI)"
        depends on LASTLINK_RADIO_SX126x_ENABLED
        select LASTLINK_RADIO_$(RADIO_NUM)_SX126x_SPI

    config LASTLINK_RADIO_$(RADIO_NUM)_SX127x_SPI
        bool "Select SX127x Family (SPI)"
        depends on LASTLINK_RADIO_SX127x_ENABLED

    choice
        prompt "Select power control for radio $(RADIO_NUM)"

        config LASTLINK_RADIO_$(RADIO_NUM)_NONE
            bool "Radio power control not available"

        config LASTLINK_RADIO_$(RADIO_NUM)_LDO2
            bool "Radio power controlled by LDO2"

    endchoice

    choice
        prompt "Radio configuration for radio $(RADIO_NUM)"
        default LASTLINK_RADIO_$(RADIO_NUM)_MODEL_CUSTOM
        help
            Select the base configuration for radio $(RADIO_NUM)

        config LASTLINK_RADIO_$(RADIO_NUM)_MODEL_CUSTOM
            bool "Custom GPIO configuration"
       
        config LASTLINK_RADIO_$(RADIO_NUM)_MODEL_TTGO
            bool "TTGO"

        config LASTLINK_RADIO_$(RADIO_NUM)_MODEL_TTGO_TBEAM_V10
            bool "TTGO T-Beam V1.0"

        config LASTLINK_RADIO_$(RADIO_NUM)_MODEL_TTGO_TBEAM_V11
            bool "TTGO T-Beam V1.1"
            select LASTLINK_RADIO_$(RADIO_NUM)_GPIO_ACTIVITY_INVERTED

        config LASTLINK_RADIO_$(RADIO_NUM)_MODEL_HELTEC
            bool "HELTEC"

        config LASTLINK_RADIO_$(RADIO_NUM)_MODEL_SPARKFUN
            bool "Sparkfun LORA Gateway"

    endchoice    

endchoice

menu "Radio $(RADIO_NUM) SPI configuration"
    depends on LASTLINK_RADIO_SX126x_ENABLED || LASTLINK_RADIO_SX127x_ENABLED
    depends on LASTLINK_RADIO_$(RADIO_NUM)_SX1261_SPI || LASTLINK_RADIO_$(RADIO_NUM)_SX1262_SPI || LASTLINK_RADIO_$(RADIO_NUM)_SX127x_SPI

    config LASTLINK_RADIO_$(RADIO_NUM)_SPI_HOST
        int "SPI bus number"
        default 2
        range 0 3
        help
            SPI bus number for the radio connection.  2 and 3 are available in
            standard ESP32 radio module.  Only 3 devices per SPI bus, so be
            careful.

    config LASTLINK_RADIO_$(RADIO_NUM)_GPIO_DIO0
        int "DIO0 GPIO line"
        default 26  if LASTLINK_RADIO_$(RADIO_NUM)_MODEL_CUSTOM
        range 1 36  if LASTLINK_RADIO_$(RADIO_NUM)_MODEL_CUSTOM
        default 26  if LASTLINK_RADIO_$(RADIO_NUM)_MODEL_HELTEC
        range 26 26 if LASTLINK_RADIO_$(RADIO_NUM)_MODEL_HELTEC
        default 26  if LASTLINK_RADIO_$(RADIO_NUM)_MODEL_TTGO
        range 26 26 if LASTLINK_RADIO_$(RADIO_NUM)_MODEL_TTGO
        default 26  if LASTLINK_RADIO_$(RADIO_NUM)_MODEL_TTGO_TBEAM_V10
        range 26 26 if LASTLINK_RADIO_$(RADIO_NUM)_MODEL_TTGO_TBEAM_V10
        default -1  if LASTLINK_RADIO_$(RADIO_NUM)_MODEL_TTGO_TBEAM_V11
        range -1 -1 if LASTLINK_RADIO_$(RADIO_NUM)_MODEL_TTGO_TBEAM_V11
        default 26  if LASTLINK_RADIO_$(RADIO_NUM)_MODEL_SPARKFUN
        range 26 26 if LASTLINK_RADIO_$(RADIO_NUM)_MODEL_SPARKFUN
        help
            Connection for the DIO0 line used to report transmit and receive interrupts.
 
    config LASTLINK_RADIO_$(RADIO_NUM)_GPIO_DIO1
        int "DIO1 GPIO line"
        default 35  if LASTLINK_RADIO_$(RADIO_NUM)_MODEL_CUSTOM
        range 1 36  if LASTLINK_RADIO_$(RADIO_NUM)_MODEL_CUSTOM
        default 35  if LASTLINK_RADIO_$(RADIO_NUM)_MODEL_HELTEC
        range 35 35 if LASTLINK_RADIO_$(RADIO_NUM)_MODEL_HELTEC
        default 33  if LASTLINK_RADIO_$(RADIO_NUM)_MODEL_TTGO
        range 33 33 if LASTLINK_RADIO_$(RADIO_NUM)_MODEL_TTGO
        default 33  if LASTLINK_RADIO_$(RADIO_NUM)_MODEL_TTGO_TBEAM_V10
        range 33 33 if LASTLINK_RADIO_$(RADIO_NUM)_MODEL_TTGO_TBEAM_V10
        default 33  if LASTLINK_RADIO_$(RADIO_NUM)_MODEL_TTGO_TBEAM_V11
        range 33 33 if LASTLINK_RADIO_$(RADIO_NUM)_MODEL_TTGO_TBEAM_V11
        default 33  if LASTLINK_RADIO_$(RADIO_NUM)_MODEL_SPARKFUN
        range 33 33 if LASTLINK_RADIO_$(RADIO_NUM)_MODEL_SPARKFUN
        help
            Connection for the DIO1 line
 
    config LASTLINK_RADIO_$(RADIO_NUM)_GPIO_DIO2
        int "DIO2 GPIO line"
        default 34  if LASTLINK_RADIO_$(RADIO_NUM)_MODEL_CUSTOM
        range 1 34  if LASTLINK_RADIO_$(RADIO_NUM)_MODEL_CUSTOM
        default 34  if LASTLINK_RADIO_$(RADIO_NUM)_MODEL_HELTEC
        range 34 34 if LASTLINK_RADIO_$(RADIO_NUM)_MODEL_HELTEC
        default 32  if LASTLINK_RADIO_$(RADIO_NUM)_MODEL_TTGO
        range 32 32 if LASTLINK_RADIO_$(RADIO_NUM)_MODEL_TTGO
        default 32  if LASTLINK_RADIO_$(RADIO_NUM)_MODEL_TTGO_TBEAM_V10
        range 32 32 if LASTLINK_RADIO_$(RADIO_NUM)_MODEL_TTGO_TBEAM_V10
        default 32  if LASTLINK_RADIO_$(RADIO_NUM)_MODEL_TTGO_TBEAM_V11
        range 32 32 if LASTLINK_RADIO_$(RADIO_NUM)_MODEL_TTGO_TBEAM_V11
        default 32  if LASTLINK_RADIO_$(RADIO_NUM)_MODEL_SPARKFUN
        range 32 32 if LASTLINK_RADIO_$(RADIO_NUM)_MODEL_SPARKFUN
        help
            Connection for the DIO2 line
 
    config LASTLINK_RADIO_$(RADIO_NUM)_IRQ_DIO_NUM
        # depends on LASTLINK_RADIO_$(RADIO_NUM)_MODEL_TTGO_TBEAM_V10 || LASTLINK_RADIO_$(RADIO_NUM)_MODEL_TTGO_TBEAM_V11
        int "DIO (not GPIO) # for IRQ"
        default 1  if LASTLINK_RADIO_$(RADIO_NUM)_MODEL_TTGO_TBEAM_V10 || LASTLINK_RADIO_$(RADIO_NUM)_MODEL_TTGO_TBEAM_V11
        range 1 1  if LASTLINK_RADIO_$(RADIO_NUM)_MODEL_TTGO_TBEAM_V10 || LASTLINK_RADIO_$(RADIO_NUM)_MODEL_TTGO_TBEAM_V11
        default 0
        range 0 0
        help
            The value of this item is the DIO slot number to be used for the IRQ signal.

    config LASTLINK_RADIO_$(RADIO_NUM)_BUSY_DIO_NUM
        # depends on LASTLINK_RADIO_$(RADIO_NUM)_MODEL_TTGO_TBEAM_V10 || LASTLINK_RADIO_$(RADIO_NUM)_MODEL_TTGO_TBEAM_V11
        int "DIO  (not GPIO)# for BUSY"
        default 2  if LASTLINK_RADIO_$(RADIO_NUM)_MODEL_TTGO_TBEAM_V10 || LASTLINK_RADIO_$(RADIO_NUM)_MODEL_TTGO_TBEAM_V11
        range 2 2  if LASTLINK_RADIO_$(RADIO_NUM)_MODEL_TTGO_TBEAM_V10 || LASTLINK_RADIO_$(RADIO_NUM)_MODEL_TTGO_TBEAM_V11
        default -1
        range -1 -1
        help
            The value of this item is the DIO slot number to be used for the busy cell

    config LASTLINK_RADIO_$(RADIO_NUM)_GPIO_SCK
        int "SCK GPIO line"
        default 5   if LASTLINK_RADIO_$(RADIO_NUM)_MODEL_CUSTOM
        range 1 36  if LASTLINK_RADIO_$(RADIO_NUM)_MODEL_CUSTOM
        default 5   if LASTLINK_RADIO_$(RADIO_NUM)_MODEL_HELTEC
        range 5 5   if LASTLINK_RADIO_$(RADIO_NUM)_MODEL_HELTEC
        default 5   if LASTLINK_RADIO_$(RADIO_NUM)_MODEL_TTGO
        range 5 5   if LASTLINK_RADIO_$(RADIO_NUM)_MODEL_TTGO
        default 5   if LASTLINK_RADIO_$(RADIO_NUM)_MODEL_TTGO_TBEAM_V10
        range 5 5   if LASTLINK_RADIO_$(RADIO_NUM)_MODEL_TTGO_TBEAM_V10
        default 5   if LASTLINK_RADIO_$(RADIO_NUM)_MODEL_TTGO_TBEAM_V11
        range 5 5   if LASTLINK_RADIO_$(RADIO_NUM)_MODEL_TTGO_TBEAM_V11
        default 14  if LASTLINK_RADIO_$(RADIO_NUM)_MODEL_SPARKFUN
        range 14 14 if LASTLINK_RADIO_$(RADIO_NUM)_MODEL_SPARKFUN
        help
            Connection for the SPI Clock line
 
    config LASTLINK_RADIO_$(RADIO_NUM)_GPIO_MOSI
        int "MOSI GPIO line"
        default 27  if LASTLINK_RADIO_$(RADIO_NUM)_MODEL_CUSTOM
        range 1 36  if LASTLINK_RADIO_$(RADIO_NUM)_MODEL_CUSTOM
        default 27  if LASTLINK_RADIO_$(RADIO_NUM)_MODEL_HELTEC
        range 27 27 if LASTLINK_RADIO_$(RADIO_NUM)_MODEL_HELTEC
        default 27  if LASTLINK_RADIO_$(RADIO_NUM)_MODEL_TTGO
        range 27 27 if LASTLINK_RADIO_$(RADIO_NUM)_MODEL_TTGO
        default 27  if LASTLINK_RADIO_$(RADIO_NUM)_MODEL_TTGO_TBEAM_V10
        range 27 27 if LASTLINK_RADIO_$(RADIO_NUM)_MODEL_TTGO_TBEAM_V10
        default 27  if LASTLINK_RADIO_$(RADIO_NUM)_MODEL_TTGO_TBEAM_V11
        range 27 27 if LASTLINK_RADIO_$(RADIO_NUM)_MODEL_TTGO_TBEAM_V11
        default 13  if LASTLINK_RADIO_$(RADIO_NUM)_MODEL_SPARKFUN
        range 13 13 if LASTLINK_RADIO_$(RADIO_NUM)_MODEL_SPARKFUN
        help
            Connection for the MOSI line
 
    config LASTLINK_RADIO_$(RADIO_NUM)_GPIO_MISO
        int "MISO GPIO line"
        default 19  if LASTLINK_RADIO_$(RADIO_NUM)_MODEL_CUSTOM
        range 1 36  if LASTLINK_RADIO_$(RADIO_NUM)_MODEL_CUSTOM
        default 19  if LASTLINK_RADIO_$(RADIO_NUM)_MODEL_HELTEC
        range 19 19 if LASTLINK_RADIO_$(RADIO_NUM)_MODEL_HELTEC
        default 19  if LASTLINK_RADIO_$(RADIO_NUM)_MODEL_TTGO
        range 19 19 if LASTLINK_RADIO_$(RADIO_NUM)_MODEL_TTGO
        default 19  if LASTLINK_RADIO_$(RADIO_NUM)_MODEL_TTGO_TBEAM_V10
        range 19 19 if LASTLINK_RADIO_$(RADIO_NUM)_MODEL_TTGO_TBEAM_V10
        default 19  if LASTLINK_RADIO_$(RADIO_NUM)_MODEL_TTGO_TBEAM_V11
        range 19 19 if LASTLINK_RADIO_$(RADIO_NUM)_MODEL_TTGO_TBEAM_V11
        default 12  if LASTLINK_RADIO_$(RADIO_NUM)_MODEL_SPARKFUN
        range 12 12 if LASTLINK_RADIO_$(RADIO_NUM)_MODEL_SPARKFUN
        help
            Connection for the MISO line
 
    config LASTLINK_RADIO_$(RADIO_NUM)_GPIO_SS
        int "SS GPIO line"
        default 18  if LASTLINK_RADIO_$(RADIO_NUM)_MODEL_CUSTOM
        range 1 36  if LASTLINK_RADIO_$(RADIO_NUM)_MODEL_CUSTOM
        default 18  if LASTLINK_RADIO_$(RADIO_NUM)_MODEL_HELTEC
        range 18 18 if LASTLINK_RADIO_$(RADIO_NUM)_MODEL_HELTEC
        default 18  if LASTLINK_RADIO_$(RADIO_NUM)_MODEL_TTGO
        range 18 18 if LASTLINK_RADIO_$(RADIO_NUM)_MODEL_TTGO
        default 18  if LASTLINK_RADIO_$(RADIO_NUM)_MODEL_TTGO_TBEAM_V10
        range 18 18 if LASTLINK_RADIO_$(RADIO_NUM)_MODEL_TTGO_TBEAM_V10
        default 18  if LASTLINK_RADIO_$(RADIO_NUM)_MODEL_TTGO_TBEAM_V11
        range 18 18 if LASTLINK_RADIO_$(RADIO_NUM)_MODEL_TTGO_TBEAM_V11
        default 16  if LASTLINK_RADIO_$(RADIO_NUM)_MODEL_SPARKFUN
        range 16 16 if LASTLINK_RADIO_$(RADIO_NUM)_MODEL_SPARKFUN
        help
            Connection for the SS (Select) line
 
    config LASTLINK_RADIO_$(RADIO_NUM)_GPIO_RESET
        int "RESET GPIO line"
        default 14  if LASTLINK_RADIO_$(RADIO_NUM)_MODEL_CUSTOM
        range 1 36  if LASTLINK_RADIO_$(RADIO_NUM)_MODEL_CUSTOM
        default 14  if LASTLINK_RADIO_$(RADIO_NUM)_MODEL_HELTEC
        range 14 14 if LASTLINK_RADIO_$(RADIO_NUM)_MODEL_HELTEC
        default 14  if LASTLINK_RADIO_$(RADIO_NUM)_MODEL_TTGO
        range 14 14 if LASTLINK_RADIO_$(RADIO_NUM)_MODEL_TTGO
        default 23  if LASTLINK_RADIO_$(RADIO_NUM)_MODEL_TTGO_TBEAM_V10
        range 23 23 if LASTLINK_RADIO_$(RADIO_NUM)_MODEL_TTGO_TBEAM_V10
        default 23  if LASTLINK_RADIO_$(RADIO_NUM)_MODEL_TTGO_TBEAM_V11
        range 23 23 if LASTLINK_RADIO_$(RADIO_NUM)_MODEL_TTGO_TBEAM_V11
        default 0   if LASTLINK_RADIO_$(RADIO_NUM)_MODEL_SPARKFUN
        range 0 0   if LASTLINK_RADIO_$(RADIO_NUM)_MODEL_SPARKFUN
        help
            Connection for the RESET line

    config LASTLINK_RADIO_$(RADIO_NUM)_GPIO_ACTIVITY
        int "Activity LED"
        default -1  if LASTLINK_RADIO_$(RADIO_NUM)_MODEL_CUSTOM
        range 1 36  if LASTLINK_RADIO_$(RADIO_NUM)_MODEL_CUSTOM
        default 25  if LASTLINK_RADIO_$(RADIO_NUM)_MODEL_HELTEC
        range 25 25 if LASTLINK_RADIO_$(RADIO_NUM)_MODEL_HELTEC
        default 0   if LASTLINK_RADIO_$(RADIO_NUM)_MODEL_TTGO
        range 0 0   if LASTLINK_RADIO_$(RADIO_NUM)_MODEL_TTGO
        default 0   if LASTLINK_RADIO_$(RADIO_NUM)_MODEL_TTGO_TBEAM_V10
        range 0 0   if LASTLINK_RADIO_$(RADIO_NUM)_MODEL_TTGO_TBEAM_V10
        default 4   if LASTLINK_RADIO_$(RADIO_NUM)_MODEL_TTGO_TBEAM_V11
        range 4 4   if LASTLINK_RADIO_$(RADIO_NUM)_MODEL_TTGO_TBEAM_V11
        default -1  if LASTLINK_RADIO_$(RADIO_NUM)_MODEL_SPARKFUN
        range -1 -1 if LASTLINK_RADIO_$(RADIO_NUM)_MODEL_SPARKFUN
        help
            Connection for the ACTIVITY LED indicator

    config LASTLINK_RADIO_$(RADIO_NUM)_GPIO_ACTIVITY_INVERTED
        depends on LASTLINK_RADIO_$(RADIO_NUM)_MODEL_TTGO_TBEAM_V11
        bool "Inverted activity LED"

    config LASTLINK_RADIO_$(RADIO_NUM)_SPI_CLOCK_HZ
        int "SPI Clock speed"
        default 10000000
        range 100000 40000000
        help
            Clock rate for the spi

    config LASTLINK_RADIO_$(RADIO_NUM)_DMA_CHAN
        int "DMA channel (0 if off)"
        default 0
        help
            Set to enable DMA (0 if disable)

    config LASTLINK_RADIO_$(RADIO_NUM)_CRYSTAL
        int "Crystal frequency"
        default 32000000
        help
            Crystal frequency

    config LASTLINK_RADIO_$(RADIO_NUM)_CHANNEL
        int "Initial channel"
        default 0
        range 0 71
        help
            Initial channel.  First 64 or narrow band.  Last 8 are wide band.

    config LASTLINK_RADIO_$(RADIO_NUM)_DATARATE
        int "Initial datarate"
        default 0
        range 0 7
        help
            Initial datarate.  Note: not all datarates are valied.

    config LASTLINK_RADIO_$(RADIO_NUM)_TRANSMIT_WINDOWS
        int "Number transmit windows"
        default 8
        range 1 20
        help
            Number of transmit slots

    config LASTLINK_RADIO_$(RADIO_NUM)_WINDOW_WIDTH_PERCENT
        int "Width expressed as percentage of max message time"
        default 100
        range 10 300
        help
            This controls the calculated width of a window in milliseconds.
            It is expressed as a percentage of calculated maximum message
            length at the selected bandwidth / coding_rate / spread_factor.

    config LASTLINK_RADIO_$(RADIO_NUM)_CAD_RESTART_DELAY
        int "mS to wait for CAD state restart"
        default 0
        range 0 1000
        help
            This slows down re-entry into and detection of packets with
            the benefit of reducing power requirements and allowing the
            radio to sleep.

endmenu
```
